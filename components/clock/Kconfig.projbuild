## components/clock/Kconfig.projbuild
```kconfig
menu "Weather Clock"

    menu "Wi-Fi"

        config CLOCK_WIFI_SSID
            string "Wi-Fi SSID"
            default ""
            help
                Network the clock joins to sync time and fetch weather. Left
                empty by default on purpose: this is a credential, and the
                default is what a fresh clone builds with.

        config CLOCK_WIFI_PASS
            string "Wi-Fi password"
            default ""
            help
                WPA2 passphrase for CLOCK_WIFI_SSID. Stored in sdkconfig,
                which is deliberately not tracked by git.

    endmenu

    menu "Time"

        config CLOCK_TIMEZONE
            string "POSIX timezone string"
            default "CET-1CEST,M3.5.0,M10.5.0/3"
            help
                Passed to setenv("TZ", ...). The default is Central European
                Time with EU daylight-saving rules. Everything displayed is
                local time; the RTC holds UTC.

        config CLOCK_NTP_SERVER
            string "NTP server"
            default "pool.ntp.org"

        config CLOCK_SYNC_HOUR_1
            int "First daily time-sync hour"
            range 0 23
            default 5
            help
                The RTC drifts slowly, so it is disciplined twice a day rather
                than on every Wi-Fi bring-up. Weather refreshes on its own,
                shorter cycle and shares a bring-up when the two coincide.

        config CLOCK_SYNC_HOUR_2
            int "Second daily time-sync hour"
            range 0 23
            default 15

    endmenu

    menu "Weather"

        config WEATHER_LATITUDE
            string "Latitude"
            default ""
            help
                Decimal degrees, as sent to Open-Meteo. Empty by default -
                a location is personal data.

        config WEATHER_LONGITUDE
            string "Longitude"
            default ""

        config WEATHER_REFRESH_MIN
            int "Weather refresh interval (minutes)"
            range 5 720
            default 30
            help
                A "current" temperature that is hours old is not a current
                temperature. Each refresh costs one Wi-Fi bring-up: at 30
                minutes that is roughly 13 mAh a day against a ~190 mAh
                budget, taking runtime from about 14 days to about 13.

        config WEATHER_STALE_CYCLES
            int "Refresh cycles before data is marked stale"
            range 1 20
            default 3
            help
                How many consecutive failed refreshes before the top bar
                shows the stale-data warning. One failure is a blip; three in
                a row is an outage worth surfacing.

    endmenu

    menu "Battery"

        config BATTERY_WARNING_MV
            int "Low-battery warning threshold (mV)"
            range 2500 4200
            default 3200

        config BATTERY_CRITICAL_MV
            int "Critical shutdown threshold (mV)"
            range 2500 4200
            default 3100
            help
                Below this the device shuts down to protect the cell. Must be
                lower than the warning threshold.

    endmenu

    menu "Diagnostics"

        config CLOCK_WIFI_STRESS
            bool "Run a Wi-Fi cycle stress test at boot"
            default n
            help
                Runs back-to-back Wi-Fi bring-up/teardown cycles at boot and
                reports how internal DRAM moves across each one, in two passes -
                one without the weather fetch, one with - so a leak in the
                HTTP/TLS path can be told from one in the radio path.

                For hunting the ESP_ERR_NO_MEM abort inside phy_track_pll_init
                that reboots the board after a few hours of normal refreshes.
                At a few seconds per cycle this reproduces it in minutes.

                Holds boot for a minute or two and hammers the access point.
                Leave off except when investigating.

        config CLOCK_WIFI_STRESS_CYCLES
            int "Cycles per pass"
            depends on CLOCK_WIFI_STRESS
            range 2 200
            default 15

        config CLOCK_MIN_HEAP_FOR_WIFI
            int "Internal DRAM floor before starting Wi-Fi (bytes, 0 disables)"
            range 0 131072
            default 57344
            help
                Bring-up is skipped when free internal DRAM is below this, and
                the refresh fails cleanly instead.

                Without it, running out during esp_wifi_start() reboots the
                board: phy_track_pll_init() wraps esp_timer_create() in
                ESP_ERROR_CHECK, so a ~60 byte allocation failing deep inside
                the PHY takes the whole device down. That allocation is
                MALLOC_CAP_INTERNAL, so the 8 MB of PSRAM cannot cover it.

                Bring-up itself costs about 49 KB of internal DRAM, measured
                on this board, so the floor is that plus a margin. Idle free
                internal is around 134 KB and the trough during a sync is
                around 60 KB, so this only trips when something is already
                badly wrong - it costs a stale reading, not an uptime.

    endmenu

endmenu
```

## firmware/components/selftest/Kconfig
```kconfig
menu "Clock self-test"

config CLOCK_SELFTEST
    bool "Run on-device self tests at boot"
    default y
    help
        Runs assertion suites at boot, logs a summary over serial, then
        continues into the normal application. Turn this off for release
        builds.

endmenu
```
